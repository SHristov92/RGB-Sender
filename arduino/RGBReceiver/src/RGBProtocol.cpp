// Reed-Solomon decoder, CRCs and header parsing for protocol v1. A port of
// js/rs.js, js/crc.js and parseHeaderInfo() in js/protocol.js.
#include "RGBProtocol.h"

const uint8_t RGB_CAL_SEQUENCE[RGB_CAL_LEN] = {RGB_R, RGB_G, RGB_B, RGB_C, RGB_M, RGB_Y, RGB_W};

// ---- GF(256), primitive polynomial 0x11D, alpha = 2. Tables live in flash. ----

static const uint8_t GF_EXP[255] PROGMEM = {
  0x01, 0x02, 0x04, 0x08, 0x10, 0x20, 0x40, 0x80, 0x1d, 0x3a, 0x74, 0xe8, 0xcd, 0x87, 0x13, 0x26,
  0x4c, 0x98, 0x2d, 0x5a, 0xb4, 0x75, 0xea, 0xc9, 0x8f, 0x03, 0x06, 0x0c, 0x18, 0x30, 0x60, 0xc0,
  0x9d, 0x27, 0x4e, 0x9c, 0x25, 0x4a, 0x94, 0x35, 0x6a, 0xd4, 0xb5, 0x77, 0xee, 0xc1, 0x9f, 0x23,
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  0x2c, 0x58, 0xb0, 0x7d, 0xfa, 0xe9, 0xcf, 0x83, 0x1b, 0x36, 0x6c, 0xd8, 0xad, 0x47, 0x8e,
};

static const uint8_t GF_LOG[256] PROGMEM = {
  0x00, 0x00, 0x01, 0x19, 0x02, 0x32, 0x1a, 0xc6, 0x03, 0xdf, 0x33, 0xee, 0x1b, 0x68, 0xc7, 0x4b,
  0x04, 0x64, 0xe0, 0x0e, 0x34, 0x8d, 0xef, 0x81, 0x1c, 0xc1, 0x69, 0xf8, 0xc8, 0x08, 0x4c, 0x71,
  0x05, 0x8a, 0x65, 0x2f, 0xe1, 0x24, 0x0f, 0x21, 0x35, 0x93, 0x8e, 0xda, 0xf0, 0x12, 0x82, 0x45,
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  0x4f, 0xae, 0xd5, 0xe9, 0xe6, 0xe7, 0xad, 0xe8, 0x74, 0xd6, 0xf4, 0xea, 0xa8, 0x50, 0x58, 0xaf,
};

static inline uint8_t gfExp(uint16_t i) { return pgm_read_byte(&GF_EXP[i % 255]); }
static inline uint8_t gfLog(uint8_t x) { return pgm_read_byte(&GF_LOG[x]); }

static inline uint8_t gfMul(uint8_t a, uint8_t b) {
  if (a == 0 || b == 0) return 0;
  return gfExp((uint16_t)gfLog(a) + gfLog(b));
}

static inline uint8_t gfDiv(uint8_t a, uint8_t b) {
  if (a == 0) return 0;
  return gfExp((uint16_t)gfLog(a) + 255 - gfLog(b));
}

// alpha^p for any integer p.
static inline uint8_t alphaPow(int16_t p) {
  p %= 255;
  if (p < 0) p += 255;
  return gfExp((uint16_t)p);
}

static bool syndromes(const uint8_t *r, uint8_t n, uint8_t nsym, uint8_t *s) {
  bool zero = true;
  for (uint8_t i = 0; i < nsym; i++) {
    uint8_t a = gfExp(i);
    uint8_t acc = 0;
    for (uint8_t j = 0; j < n; j++) acc = gfMul(acc, a) ^ r[j];
    s[i] = acc;
    if (acc) zero = false;
  }
  return zero;
}

int rgbRsDecode(uint8_t *r, uint8_t n, uint8_t nsym) {
  if (nsym == 0) return 0;
  if (nsym > RGB_MAX_NSYM || nsym >= n) return -1;

  uint8_t S[RGB_MAX_NSYM];
  if (syndromes(r, n, nsym, S)) return 0;

  // Berlekamp-Massey. Polynomials are low-degree-first.
  const uint8_t CAP = RGB_MAX_NSYM + 2;
  uint8_t C[CAP] = {1};
  uint8_t B[CAP] = {1};
  uint8_t prevC[CAP];
  uint8_t cLen = 1, bLen = 1;
  uint8_t L = 0, m = 1, b = 1;
  for (uint8_t k = 0; k < nsym; k++) {
    uint8_t d = S[k];
    for (uint8_t i = 1; i <= L; i++) d ^= gfMul(i < cLen ? C[i] : 0, S[k - i]);
    if (d == 0) {
      m++;
      continue;
    }
    uint8_t coef = gfDiv(d, b);
    uint8_t prevLen = cLen;
    for (uint8_t i = 0; i < cLen; i++) prevC[i] = C[i];
    if (bLen + m > CAP) return -1;
    while (cLen < bLen + m) C[cLen++] = 0;
    for (uint8_t i = 0; i < bLen; i++) C[i + m] ^= gfMul(coef, B[i]);
    if (2 * L <= k) {
      L = k + 1 - L;
      for (uint8_t i = 0; i < prevLen; i++) B[i] = prevC[i];
      bLen = prevLen;
      b = d;
      m = 1;
    } else {
      m++;
    }
  }
  if (2 * L > nsym) return -1;

  // Chien search over the (possibly shortened) codeword positions.
  uint8_t positions[RGB_MAX_NSYM / 2];
  uint8_t found = 0;
  for (uint8_t j = 0; j < n; j++) {
    uint8_t xInv = alphaPow(-(int16_t)(n - 1 - j));
    uint8_t v = 0;
    for (int8_t i = cLen - 1; i >= 0; i--) v = gfMul(v, xInv) ^ C[i];
    if (v == 0) {
      if (found >= L) return -1;
      positions[found++] = j;
    }
  }
  if (found != L) return -1;

  // Error evaluator Omega(x) = S(x) * Lambda(x) mod x^nsym.
  uint8_t omega[RGB_MAX_NSYM] = {0};
  for (uint8_t i = 0; i < nsym; i++)
    for (uint8_t j = 0; j < cLen && i + j < nsym; j++) omega[i + j] ^= gfMul(S[i], C[j]);

  // Forney (fcr = 0): e = X * Omega(X^-1) / Lambda'(X^-1).
  for (uint8_t e = 0; e < found; e++) {
    uint8_t j = positions[e];
    int16_t p = n - 1 - j;
    uint8_t xInv = alphaPow(-p);
    uint8_t om = 0;
    for (int8_t i = nsym - 1; i >= 0; i--) om = gfMul(om, xInv) ^ omega[i];
    uint8_t dl = 0;
    for (uint8_t i = 1; i < cLen; i += 2) dl ^= gfMul(C[i], alphaPow(-p * (int16_t)(i - 1)));
    if (dl == 0) return -1;
    r[j] ^= gfMul(alphaPow(p), gfDiv(om, dl));
  }

  if (!syndromes(r, n, nsym, S)) return -1;
  return found;
}

// ---- CRCs ----

uint16_t rgbCrc16(const uint8_t *data, size_t len) {
  uint16_t crc = 0xFFFF;
  while (len--) {
    crc ^= (uint16_t)(*data++) << 8;
    for (uint8_t i = 0; i < 8; i++) crc = (crc & 0x8000) ? (uint16_t)((crc << 1) ^ 0x1021) : (uint16_t)(crc << 1);
  }
  return crc;
}

// Bitwise to save the 1 KB table on small boards; messages are short.
uint32_t rgbCrc32(const uint8_t *data, size_t len) {
  uint32_t crc = 0xFFFFFFFFUL;
  while (len--) {
    crc ^= *data++;
    for (uint8_t i = 0; i < 8; i++) crc = (crc & 1) ? (crc >> 1) ^ 0xEDB88320UL : crc >> 1;
  }
  return ~crc;
}

// ---- Header ----

bool rgbParseHeader(const uint8_t *info, RGBFrameHeader &h) {
  uint8_t version = info[0] >> 6;
  uint8_t reserved = (info[0] >> 2) & 3;
  h.mode = (info[0] >> 4) & 3;
  h.type = info[0] & 3;
  h.sessionId = info[1];
  h.index = info[2];
  h.K = info[3];
  h.L = info[4];
  h.P = info[5] >> 4;
  h.t = info[5] & 0xF;
  h.bodyCrc = ((uint16_t)info[6] << 8) | info[7];
  return version == 1 && reserved == 0 && (h.mode == RGB_MODE_ROBUST || h.mode == RGB_MODE_DENSE) &&
         (h.type == RGB_FRAME_DATA || h.type == RGB_FRAME_PARITY) && h.K >= 1 && h.L >= 1 &&
         (uint16_t)h.L + 2 * h.t <= 255 && h.index < (h.type == RGB_FRAME_DATA ? h.K : h.P);
}
